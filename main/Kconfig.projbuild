## main/Kconfig.projbuild
```kconfig
menu "Example Configuration"

    config FIRMWARE_VERSION
        string
        default "1"

# WIFI ---------------------------------------------- WIFI
    config WIFI_SSID
        string
        default "Uitsig"

    config WIFI_PASSWORD
        string
        default "0834567432"
# END WIFI ________________________ END WIFI

# KEYS ---------------------------------------------- KEYS

    config DEVICE_PRIVATE_KEY
        string
        default "ab:05:1e:33:36:d9:b0:1e:b2:00:1a:b2:da:1c:21:84:bf:ee:46:5e:3a:7d:3f:11:1f:73:a6:4b:bd:d7:5d:f6"
# END KEYS ________________________ END KEYS


# GPIO ---------------------------------------------- GPIO
    
    # LEDs
    config WIFI_LED_PIN
        int 
        default 1
    
    config MQTT_LED_PIN
        int 
        default 2
    
    # Interrupts
    config COUNTER_PIN
        int 
        default 19
    
    config RTC_ALARM_PIN
        int
        default 20
    
    # Status
    config MAINS_SENSE_PIN
        int
        default 3

    config BAT_STATUS_PIN
        int
        default 9
    
    config BAT_SENSE_PIN
        int
        default 9  
                    # Actually GPIO 10 (ADC1_CHANNEL_9)

    config SENSOR_TYPE_PIN
        int
        default 21

    # I2c
    config I2C_SCL_PIN
        int
        default 40

    config I2C_SDA_PIN
        int
        default 39

    # SPI
    config SPI_MOSI_PIN
        int
        default 36

    config SPI_CLK_PIN
        int
        default 35

    config SPI_MISO_PIN
        int
        default 34

    config SPI_CS_FRAM_PIN
        int
        default 33

# END GPIO ________________________ END GPIO


    config LAST_KNOWN_UNIX
        int
        default 1600328461
    
    config JWT_EXP
        int
        default 3600

# GCP ---------------------------------------------- GCP
    config GCP_PROJECT_ID
        string
        default "fm-development-1"
    
    config GCP_LOCATION
        string
        default "us-central1"

    config GCP_REGISTRY
        string
        default "counter-1"

    config STATUS_SUBFOLDER
        string
        default "status-telemetry-1"

    config GCP_URI
        string
        default "mqtts://mqtt.2030.ltsapis.goog:8883"

    config GCP_HOST
        string
        default "mqtt.2030.ltsapis.goog"

    config GCP_PORT
        int
        default  8883

# END GCP ________________________ END GCP

# STATUS ---------------------------------------------- STATUS

    config STATUS_UPLOAD_INTERVAL_MIN
        int
        default  60

    # END STATUS ________________________ END STATUS



        
    # config BROKER_URI
    #     string "Broker URL"
    #     default "mqtts://mqtt.eclipse.org:8883"
    #     help
    #         URL of an mqtt broker which this example connects to.

    # config BROKER_CERTIFICATE_OVERRIDE
    #     string "Broker certificate override"
    #     default ""
    #     help
    #         Please leave empty if broker certificate included from a textfile; otherwise fill in a base64 part of PEM
    #         format certificate

    # config BROKER_CERTIFICATE_OVERRIDDEN
    #     bool
    #     default y if BROKER_CERTIFICATE_OVERRIDE != ""

endmenu
```
